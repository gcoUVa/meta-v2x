## conf/local.conf
```bitbake
MACHINE ??= "solidrun-imx6"
DISTRO ?= "poky"

PACKAGE_CLASSES ?= "package_deb"

USER_CLASSES ?= "buildstats image-mklibs image-prelink"
PATCHRESOLVE = "noop"
BB_DISKMON_DIRS ??= "\
    STOPTASKS,${TMPDIR},1G,100K \
    STOPTASKS,${DL_DIR},1G,100K \
    STOPTASKS,${SSTATE_DIR},1G,100K \
    STOPTASKS,/tmp,100M,100K \
    ABORT,${TMPDIR},100M,1K \
    ABORT,${DL_DIR},100M,1K \
    ABORT,${SSTATE_DIR},100M,1K \
    ABORT,/tmp,10M,1K"
PACKAGECONFIG_append_pn-qemu-native = " sdl"
PACKAGECONFIG_append_pn-nativesdk-qemu = " sdl"
CONF_VERSION = "1"

EXTRA_IMAGE_FEATURES ?= "debug-tweaks dev-pkgs tools-sdk"

DL_DIR ?= "${TOPDIR}/downloads"
SSTATE_DIR ?= "${TOPDIR}/sstate-cache"
TMPDIR = "${TOPDIR}/tmp"



DISTRO_FEATURES_append = " systemd cmake-native"
DISTRO_FEATURES_append = " systemd"
VIRTUAL-RUNTIME_init_manager = "systemd"
DISTRO_FEATURES_BACKFILL_CONSIDERED = "sysvinit"
VIRTUAL-RUNTIME_initscripts = ""
IMX_DEFAULT_DISTRO_FEATURES_append = " systemd"

# IMAGE_INSTALL_append = " systemd-analyze openssh vim wpa-supplicant dhcp-client openssl libnl libnl-dev libgcrypt libgpg-error wireless-regdb crda make libgcrypt python python-m2crypto python-subprocess gcc pkgconfig"
# IMAGE_INSTALL_remove = " linux-firmware-bcm4330"
# CORE_IMAGE_EXTRA_INSTALL = "python-core python-pip gcc"

GLIBC_GENERATE_LOCALES="es_ES.UTF-8"
IMAGE_LINGUAS="es-es"

ACCEPT_FSL_EULA = "1"
CONNECTIVITY_CHECK_URIS = ""

BB_NUMBER_THREADS = '8'
PARALLEL_MAKE = '-j 8'
BB_NUMBER_PARSE_THREADS = '8'
PARALLEL_MAKEINST = '-j 8'

PREFERRED_PROVIDER_virtual/kernel ?= "linux-solidrun-imx6"
# PREFERRED_VERSION_linux-imx ?= "4.9%"

RDEPENDS_kernel-base ?= ""

INHIBIT_PACKAGE_DEBUG_SPLIT = "1"

INHERIT += "extrausers"
EXTRA_USERS_PARAMS = "usermod -P sorm40 root; \
                      useradd -P sorm41 v2x; "

TOOLCHAIN_TARGET_TASK += "libgcrypt libnl libnl-dev python python-m2crypto libgpg-error"

INHIBIT_PACKAGE_DEBUG_SPLIT = "1"
```
